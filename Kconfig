## Kconfig
```kconfig
# Sensor data simulator
#
# Copyright (c) 2019 Nordic Semiconductor
#
# SPDX-License-Identifier: LicenseRef-Nordic-5-Clause
#

DT_COMPAT_ZMK_BEHAVIOR_KEY_PRESS_LIP := zmk,behavior-key-press-lip

config ZMK_BEHAVIOR_KEY_PRESS_LIP
		bool
		default $(dt_compat_enabled,$(DT_COMPAT_ZMK_BEHAVIOR_KEY_PRESS_LIP))
```

## dts/bindings/zmk,behavior-key-press-lip.yaml
```yaml
# Copyright (c) 2024 The ZMK Contributors
# SPDX-License-Identifier: MIT

description: LIP Key Press behavior

compatible: "zmk,behavior-key-press-lip"

include: one_param.yaml

properties:
  keycodes:
    type: array
    required: true
```
